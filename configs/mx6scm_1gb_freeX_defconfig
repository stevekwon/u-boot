## configs/mx6scm_1gb_freeX_defconfig
```kconfig
CONFIG_SYS_EXTRA_OPTIONS="IMX_CONFIG=board/freescale/mx6scmfreeX/imximage_scm_lpddr2.cfg,MX6Q,DDR_MB=1024,SYS_USE_SPINOR,DEFAULT_FDT_FILE=\"imx6scm-1gb-freeX-rev1-ldo.dtb\""
CONFIG_ARM=y
CONFIG_TARGET_MX6SCMFREEX=y
CONFIG_DM=y
CONFIG_DM_THERMAL=y
```

## configs/mx6scm_1gb_interleaving_evb_spinor_defconfig
```kconfig
CONFIG_SYS_EXTRA_OPTIONS="IMX_CONFIG=board/freescale/mx6scmfreeX/imximage_scm_lpddr2.cfg,MX6Q,DDR_MB=1024,SYS_BOOT_SPINOR,DEFAULT_FDT_FILE=\"imx6scm-1gb-evb-ldo.dtb\",INTERLEAVING_MODE"
CONFIG_ARM=y
CONFIG_TARGET_MX6SCMFREEX=y
CONFIG_SYS_MALLOC_F=y
CONFIG_SYS_MALLOC_F_LEN=0x400
CONFIG_DM=y
CONFIG_DM_THERMAL=y
```
